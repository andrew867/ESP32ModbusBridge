## sdkconfig.defaults
```kconfig
# ESP32-C6 Configuration Defaults

# Serial flasher config
CONFIG_ESPTOOLPY_PORT="COM1"
CONFIG_ESPTOOLPY_BAUD_921600B=y

# Partition Table
CONFIG_PARTITION_TABLE_SINGLE_APP=y

# FreeRTOS Configuration
CONFIG_FREERTOS_HZ=1000
CONFIG_FREERTOS_ASSERT_ON_UNTESTED_FUNCTION=y

# Task priorities (matching original code)
CONFIG_ESP_MAIN_TASK_STACK_SIZE=8192
CONFIG_ESP_MAIN_TASK_PRIORITY=1

# UART Configuration
CONFIG_UART_ISR_IN_IRAM=n
CONFIG_UART_SUPPORT_REF_TICK=y

# WiFi Configuration
CONFIG_ESP32_WIFI_STATIC_RX_BUFFER_NUM=10
CONFIG_ESP32_WIFI_DYNAMIC_RX_BUFFER_NUM=32
CONFIG_ESP32_WIFI_TX_BUFFER_TYPE=1
CONFIG_ESP32_WIFI_DYNAMIC_TX_BUFFER_NUM=32
CONFIG_ESP32_WIFI_AMPDU_TX_ENABLED=y
CONFIG_ESP32_WIFI_AMPDU_RX_ENABLED=y

# Bluetooth Configuration
CONFIG_BT_ENABLED=y
CONFIG_BT_BLE_ENABLED=y
CONFIG_BT_NIMBLE_ENABLED=y
CONFIG_BT_NIMBLE_ROLE_PERIPHERAL=y
CONFIG_BT_NIMBLE_ROLE_CENTRAL=y

# NVS Configuration
CONFIG_NVS_ENCRYPTION=y

# TLS/SSL Configuration
CONFIG_MBEDTLS_PSK_MODES=y
CONFIG_MBEDTLS_KEY_EXCHANGE_PSK=y

# Log Configuration
CONFIG_LOG_DEFAULT_LEVEL_INFO=y
CONFIG_LOG_DEFAULT_LEVEL=3

# Component config
CONFIG_ESP_SYSTEM_EVENT_TASK_STACK_SIZE=4096

# Memory Configuration
CONFIG_ESP32S2_SPIRAM_SUPPORT=n
CONFIG_SPIRAM=n
# IRAM optimization
CONFIG_ESP32_IRAM_AS_8BIT_ACCESSIBLE_AREA_ENABLED=n
CONFIG_ESP32_DEFAULT_CPU_FREQ_240=y
CONFIG_ESP32_DEFAULT_CPU_FREQ_MHZ=240
# Reduce IRAM usage by moving WiFi to flash
CONFIG_ESP32_WIFI_IRAM_OPT=n
CONFIG_ESP32_WIFI_RX_IRAM_OPT=n
```
